## main/Kconfig.projbuild
```kconfig
menu "Monochrome"

    config MONO_WIFI_SSID
        string "Wi-Fi network name (SSID)"
        default ""
        help
            Network that mode 3 joins. Set it with idf.py menuconfig. It is stored in the local,
            untracked sdkconfig file, so it stays out of the repository.

    config MONO_WIFI_PASSWORD
        string "Wi-Fi password"
        default ""
        help
            Leave empty for an open network.

    config MONO_PORT
        int "TCP port for incoming frames"
        default 5050
        range 1 65535

endmenu
```

## sdkconfig.defaults
```kconfig
CONFIG_IDF_TARGET="esp32s3"
CONFIG_ESPTOOLPY_FLASHSIZE_16MB=y
CONFIG_ESPTOOLPY_FLASHMODE_QIO=y
CONFIG_SPIRAM=y
CONFIG_SPIRAM_MODE_OCT=y
CONFIG_SPIRAM_SPEED_80M=y
CONFIG_ESP_DEFAULT_CPU_FREQ_MHZ_240=y
CONFIG_ESP_WIFI_TASK_PINNED_TO_CORE_1=y
CONFIG_LWIP_TCPIP_TASK_AFFINITY_CPU1=y
CONFIG_LWIP_TCP_WND_DEFAULT=32768
CONFIG_LWIP_TCP_SND_BUF_DEFAULT=16384
CONFIG_LWIP_UDP_RECVMBOX_SIZE=64
CONFIG_LWIP_TCP_RECVMBOX_SIZE=32
```
